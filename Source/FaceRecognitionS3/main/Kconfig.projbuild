## Source/FaceRecognitionS3/main/Kconfig.projbuild
```kconfig
menu "Face Recognition System Configuration"

    menu "Feature Toggles"
        config ENABLE_WEB_SERVER
            bool "Enable Web Server (Port 80/81)"
            default y
            help
                Enable Web interface for streaming and enrollment.
                
        config ENABLE_LCD
            bool "Enable ST7789 LCD Display"
            default y
            help
                Enable LCD screen rendering.
            
        config ENABLE_CONSOLE
            bool "Enable ESP Console (UART/USB)"
            default y
            help
                Enable serial console commands for debugging and enroll.
    endmenu

    menu "Camera Orientation Configuration"
        choice CAMERA_ROTATION
            prompt "Camera Rotation Angle"
            default CAMERA_ROTATION_0
            help
                Select the software camera rotation angle.

            config CAMERA_ROTATION_0
                bool "0 degrees (Landscape)"
            config CAMERA_ROTATION_90
                bool "90 degrees Clockwise (Portrait)"
            config CAMERA_ROTATION_180
                bool "180 degrees (Upside Down)"
            config CAMERA_ROTATION_270
                bool "270 degrees Counter-Clockwise (Portrait)"
        endchoice
    endmenu


    choice FACE_RECOGNITION_MODEL
        prompt "Face Recognition Model Type"
        default MODEL_TYPE_CUSTOM_MOBILENETV2
        help
            Select the model to use for face recognition.

        config MODEL_TYPE_MFN_S8_V1
            bool "Default MobileFaceNet (MFN_S8_V1)"
            help
                Standard Espressif MFN model.

        config MODEL_TYPE_MBF_S8_V1
            bool "Default MobileNet (MBF_S8_V1)"
            help
                Standard Espressif MBF model.

        config MODEL_TYPE_CUSTOM_MOBILENETV2
            bool "Custom MobileNetV2 (Reinforcement Trained)"
            help
                Custom model from TrainModel directory.
    endchoice

    menu "WiFi Station Configuration"
        config ESP_WIFI_SSID
            string "WiFi SSID"
            default "MyWiFiNetwork"
            help
                SSID of the Wi-Fi network to connect to.

        config ESP_WIFI_PASSWORD
            string "WiFi Password"
            default "MyPassword123"
            help
                Password of the Wi-Fi network.
    endmenu

    menu "Python Server Configuration"
        config PYTHON_SERVER_IP
            string "Python Server IP Address"
            default "192.168.1.5"
            help
                IP address of the Python dashboard server.

        config PYTHON_SERVER_PORT
            string "Python Server Port"
            default "8088"
            help
                Port of the Python dashboard server.
    endmenu

endmenu
```

## Source/FaceRecognitionS3/sdkconfig.defaults
```kconfig
# Board and CPU
CONFIG_IDF_TARGET="esp32s3"
CONFIG_FREERTOS_HZ=1000

# PSRAM - Critical for AI
CONFIG_SPIRAM=y
CONFIG_SPIRAM_MODE_OCT=y
CONFIG_SPIRAM_SPEED_80M=y
CONFIG_SPIRAM_BOOT_INIT=y
CONFIG_SPIRAM_USE_MALLOC=y
CONFIG_SPIRAM_MEMTEST=y
CONFIG_SPIRAM_MALLOC_RESERVE_INTERNAL=32768
CONFIG_SPIRAM_TRY_ALLOCATE_WIFI_LWIP=y

# Flash - 16MB
CONFIG_ESPTOOLPY_FLASHSIZE_16MB=y
CONFIG_ESPTOOLPY_FLASHMODE_QIO=y
CONFIG_ESPTOOLPY_FLASHFREQ_80M=y

# Partition Table
CONFIG_PARTITION_TABLE_CUSTOM=y
CONFIG_PARTITION_TABLE_CUSTOM_FILENAME="partitions.csv"
CONFIG_PARTITION_TABLE_FILENAME="partitions.csv"
CONFIG_PARTITION_TABLE_OFFSET=0x8000
CONFIG_PARTITION_TABLE_MD5=y

# ESP-DL - AI Models in Flash RODATA
CONFIG_HUMAN_FACE_DETECT_MODEL_IN_FLASH_RODATA=y
CONFIG_HUMAN_FACE_FEAT_MODEL_IN_FLASH_RODATA=y
CONFIG_HUMAN_FACE_FEAT_MFN_S8_V1=y

# Camera
CONFIG_OV3660_SUPPORT=y
CONFIG_CAMERA_TASK_STACK_SIZE=4096

# Web Server
CONFIG_HTTPD_MAX_REQ_HDR_LEN=1024
CONFIG_HTTPD_MAX_URI_LEN=1024

# Heap Debugging
CONFIG_HEAP_TRACING_OFF=y
# CONFIG_HEAP_TASK_TRACKING is not set

# Watchdog
CONFIG_ESP_TASK_WDT_TIMEOUT_S=20

# OTA Support
CONFIG_BOOTLOADER_APP_ROLLBACK_ENABLE=y
CONFIG_ESP_HTTPS_OTA_ALLOW_HTTP=y
CONFIG_HTTPD_MAX_REQ_HDR_LEN=1024
CONFIG_HTTPD_MAX_URI_LEN=1024
```
